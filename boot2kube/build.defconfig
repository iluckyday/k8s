## boot2kube/build.defconfig
```kconfig
BR2_x86_64=y
BR2_OPTIMIZE_S=y
BR2_TARGET_ENABLE_ROOT_LOGIN=y
BR2_TARGET_GENERIC_ROOT_PASSWD="root"
BR2_INIT_SYSTEMD=y
BR2_SYSTEM_BIN_SH_BUSYBOX=y
BR2_ROOTFS_OVERLAY="$(BOOT2KUBE)/rootfs-overlay"
BR2_LINUX_KERNEL=y
BR2_LINUX_KERNEL_BZIMAGE=y
BR2_LINUX_KERNEL_XZ=y
BR2_LINUX_KERNEL_USE_CUSTOM_CONFIG=y
BR2_LINUX_KERNEL_CUSTOM_CONFIG_FILE="$(BOOT2KUBE)/linux.config"
BR2_PACKAGE_LIBCURL=y
BR2_PACKAGE_LIBCURL_CURL=y
BR2_PACKAGE_OPENSSH=y
BR2_PACKAGE_CA_CERTIFICATES=y
BR2_PACKAGE_EBTABLES=y
BR2_PACKAGE_IPTABLES=y
BR2_PACKAGE_ETHTOOL=y
BR2_PACKAGE_SOCAT=y
BR2_PACKAGE_LIBRESSL=y
BR2_PACKAGE_UTIL_LINUX_NSENTER=y
BR2_TARGET_ROOTFS_CPIO=y
BR2_TARGET_ROOTFS_CPIO_XZ=y
BR2_TARGET_ROOTFS_ISO9660=y
BR2_TARGET_ROOTFS_ISO9660_BOOT_MENU="$(BOOT2KUBE)/isolinux.cfg"
BR2_TARGET_SYSLINUX=y
```
